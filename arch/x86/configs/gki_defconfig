## drivers/ivshm/Kconfig
```kconfig
# SPDX-License-Identifier: GPL-2.0-only
menuconfig IVSHM
	tristate "Inter-VM Shared Memory drivers"
	depends on MMU
	select MEMORY_HOTPLUG_SPARSE
	select MEMORY_HOTREMOVE
	select ZONE_DEVICE
	help
	  Enable this to allow the inter-VM shared memory driver core code to be
	  built.

	  If you don't know what to do here, say N.

if IVSHM

config IVSHM_IVSHMEM
	tristate "Driver for QEMU IVSHMEM"
	depends on PCI
	help
	  Driver for QEMU IVSHMEM.

config IVSHM_GUEST_SHM
	tristate "Driver for QNX guest shm"
	depends on PCI
	help
	  Driver for QNX guest shm.

endif
```

## drivers/media/platform/virtio/Kconfig
```kconfig
# SPDX-License-Identifier: GPL-2.0-only

comment "VirtIO media platform drivers"

config VIDEO_VIRTIO_CAMERA
	tristate "VirtIO camera driver"
	depends on V4L_PLATFORM_DRIVERS
	depends on VIDEO_DEV
	depends on VIRTIO
	select VIDEOBUF2_DMA_SG
	select VIRTIO_DMA_SHARED_BUFFER
	help
	  This driver provides support for VirtIO camera device. If you
	  choose 'M' here, this module will be called virtio_camera.
```

## drivers/tee/optee/Kconfig
```kconfig
# SPDX-License-Identifier: GPL-2.0-only
# OP-TEE Trusted Execution Environment Configuration
config OPTEE
	tristate "OP-TEE"
	depends on HAVE_ARM_SMCCC || X86_64
	depends on MMU
	help
	  This implements the OP-TEE Trusted Execution Environment (TEE)
	  driver.

config OPTEE_SHM_NUM_PRIV_PAGES
	int "Private Shared Memory Pages"
	default 1
	depends on OPTEE
	help
	  This sets the number of private shared memory pages to be
	  used by OP-TEE TEE driver.

config OPTEE_BENCHMARK
	bool "OP-TEE Benchmark (EXPERIMENTAL)"
	depends on OPTEE
	help
	  This enables benchmarking feature in the OP-TEE Trusted
	  Execution Environment (TEE) driver. Not supported on x86_64.

config OPTEE_HV_IKGT
	bool "OP-TEE on top of IKGT hypervisor"
	depends on OPTEE
	depends on X86_64
	help
	  This enables IKGT based SMC in the OP-TEE Trusted
	  Execution Environment (TEE) driver.

config OPTEE_VSOCK
	bool "OP-TEE SMC based on VSOCK"
	depends on OPTEE
	depends on X86_64
	help
	  This enables VSOCK based SMC in the OP-TEE Trusted
	  Execution Environment (TEE) driver.

config OPTEE_IVSHMEM
	bool "OP-TEE SMC based on IVSHMEM"
	depends on OPTEE
	depends on X86_64
	help
	  This enables IVSHMEM based SMC in the OP-TEE Trusted
	  Execution Environment (TEE) driver.
```
